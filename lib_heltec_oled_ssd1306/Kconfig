## lib_heltec_oled_ssd1306/Kconfig
```kconfig
menu "Heltec SSD1306 Oled Configuration"

config I2C_SDA_PIN
    int "I2C_SDA_PIN"
    range 0 35
    default 4
    help
	Pin Number where the SDA (I2C) pin of the Display Oled module is connected to.

config I2C_SCL_PIN
    int "I2C_SCL_PIN"
    range 0 35
    default 15
    help
	Pin Number where the SCL (I2C) pin of the Display Oled module is connected to.

config I2C_CHANNEL
    int "I2C_CHANNEL"
    range 0 3
    default 0
    help
	Pin Number to be used as the I2C_CHANNEL.

config OLED_PIN_RESET
    int "OLED_PIN_RESET"
    range 0 35
    default 16
    help
	Pin Number where the Reset pin of the Display Oled module is connected to.

endmenu
```

## lora/Kconfig
```kconfig
menu "LoRa Configuration"

config CS_GPIO
    int "CS GPIO"
    range 0 35
    default 18
    help
	Pin Number where the NCS pin of the LoRa module is connected to.

config RST_GPIO
    int "RST GPIO"
    range 0 35
    default 14
    help
	Pin Number where the NRST pin of the LoRa module is connected to.

config MISO_GPIO
    int "MISO GPIO"
    range 0 35
    default 19
    help
	Pin Number to be used as the MISO SPI signal.

config MOSI_GPIO
    int "MOSI GPIO"
    range 0 35
    default 27
    help
	Pin Number to be used as the MOSI SPI signal.

config SCK_GPIO
    int "SCK GPIO"
    range 0 35
    default 5
    help
	Pin Number to be used as the SCK SPI signal.

config IRQ_GPIO
    int "IRQ GPIO"
    range 0 35
    default 26
    help
	Pin Number to be used as the SCK SPI signal.

config DEBUG_DATA_RECEIVED_BY_LED_BUILDING
    bool "Enable the received package indicator led building"
    default n
    help 
    Enable the received package indicator led building.

config DEBUG_LED_BUILDING_GPIO
    int "Set the received package indicator led GPIO"
    range 0 35
    default 25
    depends on DEBUG_DATA_RECEIVED_BY_LED_BUILDING
    help
    Pin Number to be used as the SCK SPI signal.
        
endmenu
```
